## Documentation/devicetree/bindings/display/panel/himax,hx8399.yaml
```yaml
# SPDX-License-Identifier: (GPL-2.0-only OR BSD-2-Clause)
%YAML 1.2
---
$id: http://devicetree.org/schemas/display/panel/himax,hx8399.yaml#
$schema: http://devicetree.org/meta-schemas/core.yaml#

title: Himax HX8399 MIPI-DSI LCD panel controller

maintainers:
  - Thomas Perrot <thomas.perrot@bootlin.com>

description:
  Device tree bindings for panels based on the Himax HX8399 controller,
  such as the YOURITech ET055WU01-TT 1080x1920 IPS LCD panel connected with
  a MIPI-DSI video interface.

allOf:
  - $ref: panel-common.yaml#

properties:
  compatible:
    items:
      - enum:
          - youritech,et055wu01-tt
      - const: himax,hx8399

  reg: true

  backlight: true

  port: true

  vcc-supply:
    description: Panel power supply

required:
  - compatible
  - reg
  - backlight
  - port
  - vcc-supply

additionalProperties: false

examples:
  - |
    #include <dt-bindings/gpio/gpio.h>

    dsi {
        #address-cells = <1>;
        #size-cells = <0>;
        panel@0 {
            compatible = "youritech,et055wu01-tt", "himax,hx8399";
            reg = <0>;
            vcc-supply = <&reg_2v8_p>;
            backlight = <&backlight>;

            port {
                mipi_in_panel: endpoint {
                    remote-endpoint = <&mipi_out_panel>;
                };
            };
        };
    };

...
```
